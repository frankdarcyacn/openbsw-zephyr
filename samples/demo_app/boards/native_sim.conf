## samples/demo_app/boards/native_sim.conf
```kconfig
CONFIG_PWM=n
CONFIG_CAN_NATIVE_LINUX=y
CONFIG_UART_NATIVE_POSIX=y
CONFIG_NATIVE_UART_0_ON_OWN_PTY=y

CONFIG_NETWORKING=y
CONFIG_NET_IPV4=y
CONFIG_NET_ARP=y
CONFIG_NET_UDP=y
CONFIG_NET_TCP=y
CONFIG_NET_SOCKETS=y

CONFIG_NET_CONFIG_SETTINGS=y
CONFIG_NET_CONFIG_NEED_IPV4=y
CONFIG_NET_CONFIG_MY_IPV4_ADDR="192.0.2.1"
CONFIG_NET_CONFIG_PEER_IPV4_ADDR="192.0.2.2"
```

## west.yml
```yaml
manifest:

  remotes:

    - name: github_eclipse_openbsw
      url-base: https://github.com/eclipse-openbsw

    - name: github_zephyrproject_rtos
      url-base: https://github.com/zephyrproject-rtos

  projects:

    - name: zephyr
      remote: github_zephyrproject_rtos
      revision: v3.7.1
      import:
        # By using name-allowlist we can clone only the modules that are
        # strictly needed by the application.
        name-allowlist:
          - cmsis      # required by the ARM port
          - cmsis_6
          - hal_nxp
          - hal_adi
          - hal_rpi_pico
          - hal_stm32
          - net-tools
          - segger

    - name: openbsw
      remote: github_eclipse_openbsw
      revision: 1578c18f7ce3b4be1410419f466919fb40cb5471
```
