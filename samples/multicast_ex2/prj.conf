## CMakeLists.txt
```
cmake_minimum_required(VERSION 3.20.0)

set(OPENBSW_DIR
    ${CMAKE_CURRENT_SOURCE_DIR}/../../../openbsw
    CACHE PATH "Path to Eclipse OpenBSW")

set(INCLUDE_OPENBSW_LIBS_BSP
    OFF
    CACHE BOOL "Include openbsw/libs/bsp/ in build")

# make sure zephyr compiler options are also set for cmake modules not depending on zephyr
add_compile_options($<TARGET_PROPERTY:zephyr_interface,INTERFACE_COMPILE_OPTIONS>)

find_package(Zephyr REQUIRED HINTS $ENV{ZEPHYR_BASE})

project(multicast_ex2)

if (CONFIG_NETWORKING)
        add_compile_definitions(PLATFORM_SUPPORT_ETHERNET=1)
endif()

include(${OPENBSW_DIR}/Filelists.cmake)

target_sources(app PRIVATE
    src/main.cpp
    src/OpenBSWZephyrLogger.cpp)

target_include_directories(app PRIVATE
        include)

# Path to libraries for adaptation of OpenBSW to Zephyr
add_subdirectory(${CMAKE_CURRENT_SOURCE_DIR}/../../libs openbsw_zephyr_libs)

add_subdirectory(openbswConfig)

add_library(commonImpl INTERFACE)

add_library(asyncPlatform ALIAS asyncZephyr)

target_link_libraries(app PUBLIC util)

if (CONFIG_NETWORKING)
target_link_libraries(app PUBLIC
        zephyrEthAdapter)
endif()
```

## prj.conf
```kconfig
CONFIG_CPP=y
CONFIG_STD_CPP14=y
CONFIG_REQUIRES_FULL_LIBCPP=y

# needed for stack size measurement
CONFIG_THREAD_STACK_INFO=y
CONFIG_INIT_STACKS=y

# task switch tracing
CONFIG_TRACING=y
CONFIG_TRACING_USER=y

CONFIG_NETWORKING=y
CONFIG_NET_IPV4=y
CONFIG_NET_IPV6=y
CONFIG_NET_ARP=y
CONFIG_NET_UDP=y
CONFIG_NET_TCP=y
CONFIG_NET_SOCKETS=y
CONFIG_NET_IPV4_IGMP=y
CONFIG_NET_IPV6_MLD=y

CONFIG_NET_CONFIG_SETTINGS=y
CONFIG_NET_CONFIG_NEED_IPV4=y
CONFIG_NET_CONFIG_MY_IPV4_ADDR="192.0.2.1"
CONFIG_NET_CONFIG_PEER_IPV4_ADDR="192.0.2.2"

CONFIG_NET_LOG=y
#CONFIG_LOG_OVERRIDE_LEVEL=4

#CONFIG_NET_IF_LOG_LEVEL_DBG=y
#CONFIG_NET_L2_ETHERNET_LOG_LEVEL_DBG=y
#CONFIG_NET_SOCKETS_LOG_LEVEL_DBG=y
#CONFIG_NET_TCP_LOG_LEVEL_DBG=y
#CONFIG_NET_UDP_LOG_LEVEL_DBG=y
#CONFIG_NET_TC_LOG_LEVEL_DBG=y
##CONFIG_NET_PKT_LOG_LEVEL_DBG=y
#CONFIG_NET_UTILS_LOG_LEVEL_DBG=y
#CONFIG_NET_CONTEXT_LOG_LEVEL_DBG=y
#CONFIG_NET_ARP_LOG_LEVEL_DBG=y
#CONFIG_NET_CONN_LOG_LEVEL_DBG=y
#CONFIG_NET_ROUTE_LOG_LEVEL_DBG=y
#CONFIG_NET_CORE_LOG_LEVEL_DBG=y
#CONFIG_NET_MGMT_EVENT_LOG_LEVEL_DBG=y
#CONFIG_NET_IPV4_ACD_LOG_LEVEL_DBG=y
#CONFIG_NET_IPV4_LOG_LEVEL_DBG=y
#CONFIG_NET_IPV6_LOG_LEVEL_DBG=y
#CONFIG_NET_ICMPV4_LOG_LEVEL_DBG=y
#CONFIG_NET_ICMPV6_LOG_LEVEL_DBG=y
#CONFIG_NET_DHCPV4_LOG_LEVEL_DBG=y
##CONFIG_NET_DNS_LOG_LEVEL_DBG=y
##CONFIG_NET_MLD_LOG_LEVEL_DBG=y
##CONFIG_NET_IGMP_LOG_LEVEL_DBG=y
#CONFIG_NET_IPV6_NBR_CACHE_LOG_LEVEL_DBG=y
#CONFIG_NET_IPV6_PE_LOG_LEVEL_DBG=y
#CONFIG_NET_IPV6_ND_LOG_LEVEL_DBG=y
#CONFIG_NET_BUF_LOG_LEVEL_DBG=y
#CONFIG_NET_CONFIG_LOG_LEVEL_DBG=y
```

## src/main.cpp
```c
// Copyright 2025 Accenture.

#include "ip/to_str.h"
#include "util/string/ConstString.h"
#include <iostream>
#include <zephyrEthAdapter/udp/ZephyrDatagramSocket.h>
#include <zephyr/net/net_if.h>
#include <zephyr/net/socket.h>

#include <zephyr/logging/log.h>
#include <util/logger/Logger.h>

#include "OpenBSWZephyrLogger.h"

LOG_MODULE_REGISTER(app, 4);

using namespace ::util::string;

#define IPV6_LOCAL_IPADDR "::"
#define IPV6_MULTICAST_IPADDR "ff14:0000:0000:0000:0000:0000:0004:0000"
#define IPV6_MULTICAST_PORT 22222

class DataListener : public ::udp::IDataListener
{
public:
    DataListener() {};

    void dataReceived(
        ::udp::AbstractDatagramSocket& socket,
        ::ip::IPAddress sourceAddress,
        uint16_t sourcePort,
        ::ip::IPAddress destinationAddress,
        uint16_t length) override
        {
            char sourceAddressBuffer[INET6_ADDRSTRLEN+1];
            ip::to_str(sourceAddress, sourceAddressBuffer);
            sourceAddressBuffer[INET6_ADDRSTRLEN] = '\0';
            char destinationAddressBuffer[INET6_ADDRSTRLEN+1];
            ip::to_str(destinationAddress, destinationAddressBuffer);
            destinationAddressBuffer[INET6_ADDRSTRLEN] = '\0';
            size_t maxBytesToRead = sizeof(_receiveData);
            if (length > maxBytesToRead)
            {
                LOG_INF("dataReceived: oversized packet length=%d.", length);
            }
            else
            {
                LOG_INF("dataReceived: packet length=%d.", length);
                maxBytesToRead = length;
            }

            size_t bytesRead = socket.read(&_receiveData[0U], maxBytesToRead);

            LOG_INF("dataReceived: read %d bytes from %s:%d to %s",
                bytesRead,
                sourceAddressBuffer,
                sourcePort,
                destinationAddressBuffer);
            size_t i=0;
            for (; i+3 < bytesRead; i=i+4)
            {
                LOG_INF("dataReceived: %02X%02X%02X%02X", _receiveData[i], _receiveData[i+1], _receiveData[i+2], _receiveData[i+3]);
            }
            for (; i < bytesRead; i++)
            {
                LOG_INF("dataReceived: %02X", _receiveData[i]);
            }
        }
private:
    uint8_t _receiveData[1518U];
};

OpenBSWZephyrLogger openBSWZephyrLogger;

int main(void)
{
    ::util::logger::Logger::init(openBSWZephyrLogger, openBSWZephyrLogger);

    ::udp::ZephyrDatagramSocket socket;
    struct in6_addr addr6;
    zsock_inet_pton(AF_INET6, IPV6_LOCAL_IPADDR, &addr6);
    ::ip::IPAddress ipAddr = ::ip::make_ip6(
        addr6.s6_addr32[0],
        addr6.s6_addr32[1],
        addr6.s6_addr32[2],
        addr6.s6_addr32[3]);
    DataListener dl;
    socket.setDataListener(&dl);

    LOG_INF("Bind socket to %s:%d", IPV6_LOCAL_IPADDR, IPV6_MULTICAST_PORT);
    if(socket.bind(&ipAddr, IPV6_MULTICAST_PORT) == ::udp::AbstractDatagramSocket::ErrorCode::UDP_SOCKET_OK)
    {
        LOG_INF("Socket bound to %s:%d", IPV6_LOCAL_IPADDR, IPV6_MULTICAST_PORT);
    }
    else
    {
        LOG_INF("Failed to bind socket to %s:%d", IPV6_LOCAL_IPADDR, IPV6_MULTICAST_PORT);
        return -1;
    }

    struct in6_addr multicast_addr6;
    zsock_inet_pton(AF_INET6, IPV6_MULTICAST_IPADDR, &multicast_addr6);
    ::ip::IPAddress multicastIpAddr = ::ip::make_ip6(
        multicast_addr6.s6_addr32[0],
        multicast_addr6.s6_addr32[1],
        multicast_addr6.s6_addr32[2],
        multicast_addr6.s6_addr32[3]);

    LOG_INF("Join multicast group %s", IPV6_MULTICAST_IPADDR);
    if(socket.join(multicastIpAddr) == ::udp::AbstractDatagramSocket::ErrorCode::UDP_SOCKET_OK)
    {
        LOG_INF("Joined multicast group %s", IPV6_MULTICAST_IPADDR);
    }
    else
    {
        LOG_INF("Failed to join multicast group %s", IPV6_MULTICAST_IPADDR);
        return -1;
    }

    LOG_INF("Up and running");

    return 0;
}
```

## include/OpenBSWZephyrLogger.h
```c
#pragma once

#include <util/logger/IComponentMapping.h>
#include <util/logger/ILoggerOutput.h>

using namespace util::logger;

class OpenBSWZephyrLogger
: public IComponentMapping
, public ILoggerOutput
{
    bool isEnabled(uint8_t componentIndex, Level level) const override;

    Level getLevel(uint8_t componentIndex) const override;

    LevelInfo getLevelInfo(Level level) const override;

    ComponentInfo getComponentInfo(uint8_t componentIndex) const override;

    void logOutput(
        ComponentInfo const& componentInfo,
        LevelInfo const& levelInfo,
        char const* str,
        va_list ap) override;
};
```
