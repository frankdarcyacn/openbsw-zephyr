## CMakeLists.txt
```
cmake_minimum_required(VERSION 3.20.0)

set(OPENBSW_DIR
    ${CMAKE_CURRENT_SOURCE_DIR}/../../../openbsw
    CACHE PATH "Path to Eclipse OpenBSW")

set(INCLUDE_OPENBSW_LIBS_BSP
    OFF
    CACHE BOOL "Include openbsw/libs/bsp/ in build")

# make sure zephyr compiler options are also set for cmake modules not depending on zephyr
add_compile_options($<TARGET_PROPERTY:zephyr_interface,INTERFACE_COMPILE_OPTIONS>)

find_package(Zephyr REQUIRED HINTS $ENV{ZEPHYR_BASE})

project(multicast_ex1)

if (CONFIG_NETWORKING)
        add_compile_definitions(PLATFORM_SUPPORT_ETHERNET=1)
endif()

include(${OPENBSW_DIR}/Filelists.cmake)

target_sources(app PRIVATE
    src/main.cpp
    src/OpenBSWZephyrLogger.cpp)

target_include_directories(app PRIVATE
        include)

# Path to libraries for adaptation of OpenBSW to Zephyr
add_subdirectory(${CMAKE_CURRENT_SOURCE_DIR}/../../libs openbsw_zephyr_libs)

add_subdirectory(openbswConfig)

add_library(commonImpl INTERFACE)

add_library(asyncPlatform ALIAS asyncZephyr)

target_link_libraries(app PUBLIC util)

if (CONFIG_NETWORKING)
target_link_libraries(app PUBLIC
        zephyrEthAdapter)
endif()
```

## prj.conf
```kconfig
CONFIG_CPP=y
CONFIG_STD_CPP14=y
CONFIG_REQUIRES_FULL_LIBCPP=y

# needed for stack size measurement
CONFIG_THREAD_STACK_INFO=y
CONFIG_INIT_STACKS=y

# task switch tracing
CONFIG_TRACING=y
CONFIG_TRACING_USER=y

CONFIG_NETWORKING=y
CONFIG_NET_IPV4=y
#CONFIG_NET_IPV6=y
CONFIG_NET_ARP=y
CONFIG_NET_UDP=y
CONFIG_NET_TCP=y
CONFIG_NET_SOCKETS=y
CONFIG_NET_IPV4_IGMP=y
#CONFIG_NET_IPV6_MLD=y

CONFIG_NET_CONFIG_SETTINGS=y
CONFIG_NET_CONFIG_NEED_IPV4=y
CONFIG_NET_CONFIG_MY_IPV4_ADDR="192.0.2.1"
CONFIG_NET_CONFIG_PEER_IPV4_ADDR="192.0.2.2"

CONFIG_NET_LOG=y
#CONFIG_LOG_OVERRIDE_LEVEL=4

#CONFIG_NET_IF_LOG_LEVEL_DBG=y
#CONFIG_NET_L2_ETHERNET_LOG_LEVEL_DBG=y
#CONFIG_NET_SOCKETS_LOG_LEVEL_DBG=y
#CONFIG_NET_TCP_LOG_LEVEL_DBG=y
#CONFIG_NET_UDP_LOG_LEVEL_DBG=y
#CONFIG_NET_TC_LOG_LEVEL_DBG=y
##CONFIG_NET_PKT_LOG_LEVEL_DBG=y
#CONFIG_NET_UTILS_LOG_LEVEL_DBG=y
#CONFIG_NET_CONTEXT_LOG_LEVEL_DBG=y
#CONFIG_NET_ARP_LOG_LEVEL_DBG=y
#CONFIG_NET_CONN_LOG_LEVEL_DBG=y
#CONFIG_NET_ROUTE_LOG_LEVEL_DBG=y
#CONFIG_NET_CORE_LOG_LEVEL_DBG=y
#CONFIG_NET_MGMT_EVENT_LOG_LEVEL_DBG=y
#CONFIG_NET_IPV4_ACD_LOG_LEVEL_DBG=y
#CONFIG_NET_IPV4_LOG_LEVEL_DBG=y
##CONFIG_NET_IPV6_LOG_LEVEL_DBG=y
#CONFIG_NET_ICMPV4_LOG_LEVEL_DBG=y
##CONFIG_NET_ICMPV6_LOG_LEVEL_DBG=y
#CONFIG_NET_DHCPV4_LOG_LEVEL_DBG=y
##CONFIG_NET_DNS_LOG_LEVEL_DBG=y
##CONFIG_NET_MLD_LOG_LEVEL_DBG=y
##CONFIG_NET_IGMP_LOG_LEVEL_DBG=y
##CONFIG_NET_IPV6_NBR_CACHE_LOG_LEVEL_DBG=y
##CONFIG_NET_IPV6_PE_LOG_LEVEL_DBG=y
##CONFIG_NET_IPV6_ND_LOG_LEVEL_DBG=y
#CONFIG_NET_BUF_LOG_LEVEL_DBG=y
#CONFIG_NET_CONFIG_LOG_LEVEL_DBG=y
```

## src/main.cpp
```c
// Copyright 2025 Accenture.

#include "ip/to_str.h"
#include "util/string/ConstString.h"
#include <iostream>
#include <zephyrEthAdapter/udp/ZephyrDatagramSocket.h>
#include <zephyr/net/net_if.h>
#include <zephyr/net/socket.h>

#include <zephyr/logging/log.h>
#include <util/logger/Logger.h>

#include "OpenBSWZephyrLogger.h"

LOG_MODULE_REGISTER(app, 4);

using namespace ::util::string;

#define IPV4_LOCAL_IPADDR "0.0.0.0"
#define IPV4_MULTICAST_IPADDR "239.10.20.30"
#define IPV4_MULTICAST_PORT 30490


class DataListener : public ::udp::IDataListener
{
public:
    DataListener() {};

    void dataReceived(
        ::udp::AbstractDatagramSocket& socket,
        ::ip::IPAddress sourceAddress,
        uint16_t sourcePort,
        ::ip::IPAddress destinationAddress,
        uint16_t length) override
        {
            char sourceAddressBuffer[INET_ADDRSTRLEN+1];
            ip::to_str(sourceAddress, sourceAddressBuffer);
            sourceAddressBuffer[INET_ADDRSTRLEN] = '\0';
            char destinationAddressBuffer[INET_ADDRSTRLEN+1];
            ip::to_str(destinationAddress, destinationAddressBuffer);
            destinationAddressBuffer[INET_ADDRSTRLEN] = '\0';
            size_t maxBytesToRead = sizeof(_receiveData);
            if (length > maxBytesToRead)
            {
                LOG_INF("dataReceived: oversized packet length=%d.", length);
            }
            else
            {
                LOG_INF("dataReceived: packet length=%d.", length);
                maxBytesToRead = length;
            }

            size_t bytesRead = socket.read(&_receiveData[0U], maxBytesToRead);

            LOG_INF("dataReceived: read %d bytes from %s:%d to %s",
                bytesRead,
                sourceAddressBuffer,
                sourcePort,
                destinationAddressBuffer);
            size_t i=0;
            for (; i+3 < bytesRead; i=i+4)
            {
                LOG_INF("dataReceived: %02X%02X%02X%02X", _receiveData[i], _receiveData[i+1], _receiveData[i+2], _receiveData[i+3]);
            }
            for (; i < bytesRead; i++)
            {
                LOG_INF("dataReceived: %02X", _receiveData[i]);
            }
        }
private:
    uint8_t _receiveData[1518U];
};


OpenBSWZephyrLogger openBSWZephyrLogger;

int main(void)
{
    ::util::logger::Logger::init(openBSWZephyrLogger, openBSWZephyrLogger);

    ::udp::ZephyrDatagramSocket socket;
    struct in_addr addr4;
    zsock_inet_pton(AF_INET, IPV4_LOCAL_IPADDR, &addr4);
    ::ip::IPAddress ipAddr = ::ip::make_ip4(
        addr4.s4_addr[0],
        addr4.s4_addr[1],
        addr4.s4_addr[2],
        addr4.s4_addr[3]);
    DataListener dl;
    socket.setDataListener(&dl);

    LOG_INF("Bind socket to %s:%d", IPV4_LOCAL_IPADDR, IPV4_MULTICAST_PORT);
    if(socket.bind(&ipAddr, IPV4_MULTICAST_PORT) == ::udp::AbstractDatagramSocket::ErrorCode::UDP_SOCKET_OK)
    {
        LOG_INF("Socket bound to %s:%d", IPV4_LOCAL_IPADDR, IPV4_MULTICAST_PORT);
    }
    else
    {
        LOG_INF("Failed to bind socket to %s:%d", IPV4_LOCAL_IPADDR, IPV4_MULTICAST_PORT);
        return -1;
    }

    struct in_addr multicast_addr4;
    zsock_inet_pton(AF_INET, IPV4_MULTICAST_IPADDR, &multicast_addr4);
    ::ip::IPAddress multicastIpAddr = ::ip::make_ip4(
        multicast_addr4.s4_addr[0],
        multicast_addr4.s4_addr[1],
        multicast_addr4.s4_addr[2],
        multicast_addr4.s4_addr[3]);

    LOG_INF("Join multicast group %s", IPV4_MULTICAST_IPADDR);
    if(socket.join(multicastIpAddr) == ::udp::AbstractDatagramSocket::ErrorCode::UDP_SOCKET_OK)
    {
        LOG_INF("Joined multicast group %s", IPV4_MULTICAST_IPADDR);
    }
    else
    {
        LOG_INF("Failed to join multicast group %s", IPV4_MULTICAST_IPADDR);
        return -1;
    }

    LOG_INF("Up and running");

    return 0;
}
```

## src/OpenBSWZephyrLogger.cpp
```c
#include "OpenBSWZephyrLogger.h"
#include <stdio.h>
#include <zephyr/logging/log.h>

LOG_MODULE_REGISTER(openbsw, 4);

bool OpenBSWZephyrLogger::isEnabled(uint8_t componentIndex, Level level) const { return true; }

Level OpenBSWZephyrLogger::getLevel(uint8_t componentIndex) const { return LEVEL_DEBUG; }

LevelInfo OpenBSWZephyrLogger::getLevelInfo(Level level) const
{ 
    return LevelInfo(LevelInfo::getDefaultTable() + level);
}

ComponentInfo OpenBSWZephyrLogger::getComponentInfo(uint8_t componentIndex) const
{
    return ComponentInfo{};
}

void OpenBSWZephyrLogger::logOutput(
    ComponentInfo const& componentInfo,
    LevelInfo const& levelInfo,
    char const* str,
    va_list ap)
{
    char buf[256];
    vsnprintf(buf, sizeof(buf), str, ap);
    switch (levelInfo.getLevel())
    {
    case LEVEL_CRITICAL:
        LOG_ERR("%s", buf);
        break;
    case LEVEL_ERROR:
        LOG_ERR("%s", buf);
        break;
    case LEVEL_WARN:
        LOG_WRN("%s", buf);
        break;
    case LEVEL_INFO:
        LOG_INF("%s", buf);
        break;
    case LEVEL_DEBUG:
        LOG_DBG("%s", buf);
        break;
    default:
        break;
    }
}
```
